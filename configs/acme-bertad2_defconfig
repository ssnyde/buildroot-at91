## configs/acme-bertad2_defconfig
```kconfig
BR2_arm=y
BR2_cortex_a5=y
BR2_ARM_ENABLE_NEON=y
BR2_ARM_ENABLE_VFP=y
BR2_ARM_INSTRUCTIONS_THUMB2=y
BR2_RELRO_FULL=y
BR2_TOOLCHAIN_BUILDROOT_GLIBC=y
BR2_PACKAGE_HOST_LINUX_HEADERS_CUSTOM_5_4=y
BR2_BINUTILS_VERSION_2_36_X=y
BR2_GCC_VERSION_10_X=y
BR2_TOOLCHAIN_BUILDROOT_CXX=y
BR2_TARGET_GENERIC_HOSTNAME="roadrunner"
BR2_TARGET_GENERIC_ISSUE="Welcome to RoadRunner-Buildroot"
BR2_TARGET_GENERIC_ROOT_PASSWD="acmesystems"
BR2_ROOTFS_OVERLAY="$(TOPDIR)/board/acmesystems/bertad2/rootfs_overlay"
BR2_ROOTFS_POST_IMAGE_SCRIPT="support/scripts/genimage.sh"
BR2_ROOTFS_POST_SCRIPT_ARGS="-c board/acmesystems/bertad2/genimage.cfg"
BR2_LINUX_KERNEL=y
BR2_LINUX_KERNEL_CUSTOM_GIT=y
BR2_LINUX_KERNEL_CUSTOM_REPO_URL="https://github.com/ssnyde/linux-at91.git"
BR2_LINUX_KERNEL_CUSTOM_REPO_VERSION="master-bertad2"
BR2_LINUX_KERNEL_DEFCONFIG="acme-roadrunner"
BR2_LINUX_KERNEL_DTS_SUPPORT=y
BR2_LINUX_KERNEL_INTREE_DTS_NAME="acme-roadrunner"
BR2_LINUX_KERNEL_INSTALL_TARGET=y
BR2_PACKAGE_GIT=y
BR2_PACKAGE_MEMTESTER=y
BR2_PACKAGE_PYTHON3=y
BR2_PACKAGE_PYTHON_LXML=y
BR2_PACKAGE_PYTHON_PAHO_MQTT=y
BR2_PACKAGE_PYTHON_PIP=y
BR2_PACKAGE_PYTHON_SERIAL=y
BR2_PACKAGE_LIBOPENSSL_BIN=y
BR2_PACKAGE_HAVEGED=y
BR2_PACKAGE_DROPBEAR=y
BR2_PACKAGE_OPENSSH=y
BR2_PACKAGE_PPPD=y
BR2_PACKAGE_NANO=y
BR2_TARGET_ROOTFS_EXT2=y
BR2_TARGET_ROOTFS_EXT2_4=y
BR2_TARGET_ROOTFS_EXT2_SIZE="128M"
BR2_TARGET_AT91BOOTSTRAP3=y
BR2_TARGET_AT91BOOTSTRAP3_CUSTOM_GIT=y
BR2_TARGET_AT91BOOTSTRAP3_CUSTOM_REPO_URL="https://github.com/linux4sam/at91bootstrap.git"
BR2_TARGET_AT91BOOTSTRAP3_CUSTOM_REPO_VERSION="v3.10.4"
BR2_TARGET_AT91BOOTSTRAP3_DEFCONFIG="sama5d2_roadrunner"
BR2_PACKAGE_HOST_CMAKE=y
BR2_PACKAGE_HOST_DOSFSTOOLS=y
BR2_PACKAGE_HOST_DTC=y
BR2_PACKAGE_HOST_GENIMAGE=y
BR2_PACKAGE_HOST_MTOOLS=y
BR2_PACKAGE_AWS_IOT_DEVICE_SDK_PYTHON_V2=y
```

## package/python-pybgapi/Config.in
```kconfig
config BR2_PACKAGE_PYTHON_PYBGAPI
       bool "python-pybgapi"
       select python-serial
       help
         This package provides a Python interface for the BGAPI binary protocol.
	 It reads the BGAPI definition file and dynamically generates
	 a parser for it.

	 https://pypi.org/project/pybgapi/

 
```
